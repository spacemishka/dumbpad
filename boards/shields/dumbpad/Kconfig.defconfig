## boards/shields/dumbpad/Kconfig.defconfig
```kconfig
if SHIELD_ZHERKIN

config ZMK_USB
	default n

#config ZMK_ZHERKIN
#    default "Dumbpad"
config ZMK_KEYBOARD_NAME
    default "dumbpad"
endif
```
